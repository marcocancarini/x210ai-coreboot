## config/x210ai-tpm.defconfig
```kconfig
CONFIG_VENDOR_51NB=y
CONFIG_BOARD_51NB_X210AI=y
CONFIG_PAYLOAD_EDK2=y
CONFIG_SMMSTORE=y
CONFIG_DISABLE_HECI1_AT_PRE_BOOT=y
CONFIG_TPM_MEASURED_BOOT=y
```

## heads/coreboot-x210ai.defconfig
```kconfig
CONFIG_VENDOR_51NB=y
CONFIG_BOARD_51NB_X210AI=y
CONFIG_DISABLE_HECI1_AT_PRE_BOOT=y
CONFIG_TPM_MEASURED_BOOT=y
CONFIG_CPU_MICROCODE_CBFS_EXTERNAL_BINS=y
CONFIG_CPU_UCODE_BINARIES="@BLOB_DIR@/x210ai/06-aa-04 @BLOB_DIR@/x210ai/06-b5-00 @BLOB_DIR@/x210ai/06-c6-02"
CONFIG_PAYLOAD_LINUX=y
CONFIG_PAYLOAD_FILE="@BOARD_BUILD_DIR@/bzImage"
CONFIG_LINUX_INITRD="@BOARD_BUILD_DIR@/initrd.cpio.xz"
CONFIG_LINUX_COMMAND_LINE="quiet loglevel=2"
```
